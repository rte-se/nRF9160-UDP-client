## Kconfig
```
menu "Zephyr Kernel"
source "$ZEPHYR_BASE/Kconfig.zephyr"
endmenu

module = MAIN
module-str = MAIN
source "${ZEPHYR_BASE}/subsys/logging/Kconfig.template.log_config"
```

## west.yml
```
manifest:
  remotes:
    - name: nordic
      url-base: https://github.com/nrfconnect
  projects:
    - name: sdk-nrf
      path: nrf
      remote: nordic
      revision: v1.4.0
      import: true
  self:
    path: udp-test
```

## prj.conf
```kconfig
# General config
CONFIG_ASSERT=n

# Logging
CONFIG_LOG=y
CONFIG_LOG_STRDUP_MAX_STRING=64

# AT host library
CONFIG_AT_HOST_LIBRARY=y
CONFIG_AT_CMD_THREAD_STACK_SIZE=2048
CONFIG_UART_INTERRUPT_DRIVEN=y

# Network
CONFIG_MODEM_INFO=y
CONFIG_NETWORKING=y
CONFIG_NET_SOCKETS=y
CONFIG_NET_SOCKETS_OFFLOAD=y

# LTE link control
CONFIG_LTE_LINK_CONTROL=y
CONFIG_LTE_AUTO_INIT_AND_CONNECT=y
CONFIG_LTE_PDP_CMD=y
CONFIG_LTE_PDP_CONTEXT="0,\"IP\",\"telenor.iotgw\""
CONFIG_MODEM_INFO_ADD_DATE_TIME=n

# BSD library
CONFIG_BSD_LIBRARY=y
CONFIG_BSD_LIBRARY_TRACE_ENABLED=n

# Sensors
CONFIG_I2C=y
CONFIG_SENSOR=y
CONFIG_PWM=y

# LIBS, floating point support
CONFIG_NEWLIB_LIBC=y
CONFIG_NEWLIB_LIBC_NANO=n
CONFIG_XOROSHIRO_RANDOM_GENERATOR=y

# Heap and stacks
CONFIG_HEAP_MEM_POOL_SIZE=16384
CONFIG_MAIN_STACK_SIZE=8192
CONFIG_SYSTEM_WORKQUEUE_STACK_SIZE=8192
CONFIG_HW_STACK_PROTECTION=y

# Disable native network stack to save some memory
CONFIG_NET_IPV4=n
CONFIG_NET_IPV6=n
CONFIG_NET_UDP=n
CONFIG_NET_TCP=n
CONFIG_NET_RX_STACK_SIZE=5120
CONFIG_NET_TX_STACK_SIZE=2048

# Build without bootloader
CONFIG_BOOTLOADER_MCUBOOT=y

# Debug
CONFIG_NO_OPTIMIZATIONS=n
CONFIG_DEBUG=n
```

## src/main.c
```c
#include <zephyr.h>
#include <stdio.h>
#include <net/socket.h>
#include <logging/log.h>
#include <errno.h>

#include "modem.h"
#include "led.h"

#define LOG_LEVEL CONFIG_MAIN_LOG_LEVEL
LOG_MODULE_REGISTER(MAIN);

#define SEND_INTERVAL_MS 10000
#define UDP_SERVER_IP "35.228.246.246"
#define UDP_SERVER_PORT 1234

static uint8_t receive_buffer[256];

static struct sockaddr_in local_addr;
static struct sockaddr_in remote_addr;


bool udp_echo_test(const char *message) {

  set_led_0(true);

  int sock = socket(AF_INET, SOCK_DGRAM, IPPROTO_UDP);
  if (sock < 0) {
    LOG_ERR("Error opening socket: %d", errno);
    return false;
  }

  int err = bind(sock, (struct sockaddr *)&local_addr,
     sizeof(local_addr));
  if (err < 0) {
    LOG_ERR("bind err: %d", err);
    close(sock);
    return false;
  }
  
  err = blocking_connect(sock, (struct sockaddr *)&remote_addr,
  		       sizeof(struct sockaddr_in));
  if (err < 0) {
    LOG_ERR("Connect error: %d %d", err, errno);
    close(sock);
    return false;
  }

  int send_res = send(sock, message, strlen(message), 0);
  LOG_INF("Sent %d chars: \"%s\"", send_res, message);
  if (send_res < 0) {
    LOG_ERR("Send error: %d %d", send_res, errno);
    close(sock);
    return false;
  }

  int recv_res = blocking_recv(sock, receive_buffer, 256, 0);
  LOG_INF("Received %d chars: \"%s\"", recv_res, log_strdup(receive_buffer));

  close(sock);
  set_led_0(false);
  return true;
}


void main(void) {
  int64_t next_send_time = SEND_INTERVAL_MS;

  LOG_INF("Initialising board");

  modem_init();

  if (!led_init()) {
    LOG_INF("Unable to initialize LED");
  }

  LOG_INF("Board inited! %s", CONFIG_BOARD);

  local_addr.sin_family = AF_INET;
  local_addr.sin_port = htons(0);
  local_addr.sin_addr.s_addr = 0;

  remote_addr.sin_family = AF_INET;
  remote_addr.sin_port = htons(UDP_SERVER_PORT);
  net_addr_pton(AF_INET, UDP_SERVER_IP, &remote_addr.sin_addr);

  next_send_time = k_uptime_get();

  while (1) {

    if (k_uptime_get() >= next_send_time) {

      if (udp_echo_test("Hello on UDP!")) {
        LOG_INF("Echo ok!"); 
      } else {
        LOG_INF("Failed with echo");
      }

      next_send_time += SEND_INTERVAL_MS;
    }

    int64_t remaining = next_send_time - k_uptime_get();
    if (remaining < 0) {
      remaining = 0;
    }
    k_sleep(K_MSEC(remaining));
  }
}
```

## src/board.c
```c
#include <stdio.h>

#include <zephyr.h>
#include <logging/log.h>

#include "board.h"
#include "modem.h"
#include "led.h"

#define LOG_LEVEL CONFIG_BOARD_LOG_LEVEL
LOG_MODULE_REGISTER(BOARD);

enum {
  MESSAGE_MODEM,
  MESSAGE_SENSORS,
};

static MESSAGE last_message;

void board_init() {
  LOG_INF("Initialising board");

  modem_init();

  if (NULL == led_init()) {
    LOG_INF("Unable to initialize LED, darkness follows.");
  }

}

void board_dump_modem_message(uint8_t *buffer, int len) {

  modem_sample(&last_message.modem);
  last_message.uptime = k_uptime_get() / 1000;

  snprintf(buffer, len, "%d,%lld,%d,%d,%s,%d,%d,%s,%s,%s,%d,%d",
    MESSAGE_MODEM,
    last_message.uptime,
    last_message.modem.current_band,
    last_message.modem.area_code,
    last_message.modem.current_operator,
    last_message.modem.mcc,
    last_message.modem.mnc,
    last_message.modem.cellid_hex,
    last_message.modem.ip_address,
    last_message.modem.modem_fw,
    last_message.modem.battery,
    last_message.modem.imei);
}
```

## src/board.h
```c
#pragma once

#include "modem.h"

typedef struct {
  modem_t modem;
  int64_t uptime;
} MESSAGE;

void board_init(void);

void board_dump_modem_message(uint8_t *buffer, int len);
```

## src/led.c
```c
#include <zephyr.h>
#include <device.h>
#include <drivers/gpio.h>
#include <logging/log.h>
#include <devicetree.h>

#include "led.h"

#define LOG_LEVEL CONFIG_LED_LOG_LEVEL
LOG_MODULE_REGISTER(LED);

#define LED0_NODE DT_ALIAS(led0)

static led_t led;

bool led_init() {

  led.led_dev = device_get_binding(DT_GPIO_LABEL(LED0_NODE, gpios));
  if (led.led_dev == NULL) {
    LOG_ERR("LED binding error");
    return false;
  }
  
  int ret = gpio_pin_configure(led.led_dev, DT_GPIO_PIN(LED0_NODE, gpios), GPIO_OUTPUT_ACTIVE | DT_GPIO_FLAGS(LED0_NODE, gpios));
  if (ret < 0) {
    LOG_ERR("LED config error");
    return false;
  }

  return true;
}

void set_led_0(bool on_off) {
  gpio_pin_set(led.led_dev, DT_GPIO_PIN(LED0_NODE, gpios), (int)on_off);
}
```

## src/led.h
```c
#pragma once

#include <device.h>

typedef struct {
  const struct device *led_dev;
} led_t;


bool led_init();

void set_led_0(bool on_off);
```

## src/modem.c
```c
#include <zephyr.h>
#include <modem/lte_lc.h>
#include <modem/modem_info.h>
#include <logging/log.h>
#include <stdio.h>

#include "modem.h"

#define LOG_LEVEL CONFIG_MODEM_LOG_LEVEL
LOG_MODULE_REGISTER(MODEM);

struct modem_param_info modem_param;
static MESSAGE last_message;

void modem_init() {
  int err;

#if defined(CONFIG_LTE_LINK_CONTROL)
  if (!IS_ENABLED(CONFIG_LTE_AUTO_INIT_AND_CONNECT)) {
    LOG_INF("LTE Link Connecting...");
    err = lte_lc_init_and_connect();
    __ASSERT(err == 0, "LTE link could not be established.");
    LOG_INF("LTE Link Connected!");
  }
#endif /* defined(CONFIG_LTE_LINK_CONTROL) */

  err = modem_info_init();
  __ASSERT(err == 0, "Modem info module could not be initialized.");
  err = modem_info_params_init(&modem_param);
  __ASSERT(err == 0, "Modem info parameter structure could not be initialized.");
}

void modem_sample(modem_t *modem) {
  int err;

  // Null out

  err = modem_info_params_get(&modem_param);
  if (err == 0) {
    modem->current_band = modem_param.network.current_band.value;
    modem->area_code = modem_param.network.area_code.value;
    memcpy(&modem->current_operator, &modem_param.network.current_operator.value_string, 100);
    modem->mcc = modem_param.network.mcc.value;
    modem->mnc = modem_param.network.mnc.value;
    memcpy(&modem->cellid_hex, &modem_param.network.cellid_hex.value_string, 100);
    memcpy(&modem->ip_address, &modem_param.network.ip_address.value_string, 100);
    memcpy(&modem->modem_fw, &modem_param.device.modem_fw.value_string, 100);
    modem->battery = modem_param.device.battery.value;
    modem->imei = modem_param.device.imei.value;
  }
}

void board_dump_modem_message(uint8_t *buffer, int len) {

  modem_sample(&last_message.modem);
  last_message.uptime = k_uptime_get() / 1000;

  snprintf(buffer, len, "%lld,%d,%d,%s,%d,%d,%s,%s,%s,%d,%d",
    last_message.uptime,
    last_message.modem.current_band,
    last_message.modem.area_code,
    last_message.modem.current_operator,
    last_message.modem.mcc,
    last_message.modem.mnc,
    last_message.modem.cellid_hex,
    last_message.modem.ip_address,
    last_message.modem.modem_fw,
    last_message.modem.battery,
    last_message.modem.imei);
}

int blocking_connect(int fd, struct sockaddr *local_addr, socklen_t len)
{
	int err;

	do {
		err = connect(fd, local_addr, len);

	} while (err < 0 && errno == EAGAIN);

	return err;
}

int blocking_recv(int fd, void *buf, size_t size, int flags)
{
	int err;

	do {
		err = recv(fd, buf, size, flags);
	} while (err < 0 && errno == EAGAIN);

	return err;
}

int blocking_send(int fd, const void *buf, size_t size, int flags)
{
	int err;

	do {
		err = send(fd, buf, size, flags);
	} while (err < 0 && errno == EAGAIN);

	return err;
}
```

## src/modem.h
```c
#pragma once

#include <net/socket.h>

typedef struct {
  uint16_t current_band;
  uint16_t area_code;
  char current_operator[100];
  uint16_t mcc;
  uint16_t mnc;
  char cellid_hex[100];
  char ip_address[100];
  char modem_fw[100];
  uint16_t battery;
  uint16_t imei;
} modem_t;

typedef struct {
  modem_t modem;
  int64_t uptime;
} MESSAGE;

void modem_init();

void modem_sample(modem_t *modem);

int blocking_connect(int fd, struct sockaddr *local_addr, socklen_t len);

int blocking_recv(int fd, void *buf, size_t size, int flags);

int blocking_send(int fd, const void *buf, size_t size, int flags);
```
